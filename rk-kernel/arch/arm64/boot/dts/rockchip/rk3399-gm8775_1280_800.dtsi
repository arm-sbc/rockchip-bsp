/*
 * Copyright (c) 2017 Fuzhou Rockchip Electronics Co., Ltd
 *
 * This file is dual-licensed: you can use it either under the terms
 * of the GPL or the X11 license, at your option. Note that this dual
 * licensing only applies to this file, and not this project as a
 * whole.
 *
 *  a) This file is free software; you can redistribute it and/or
 *     modify it under the terms of the GNU General Public License as
 *     published by the Free Software Foundation; either version 2 of the
 *     License, or (at your option) any later version.
 *
 *     This file is distributed in the hope that it will be useful,
 *     but WITHOUT ANY WARRANTY; without even the implied warranty of
 *     MERCHANTABILITY or FITNESS FOR A PARTICULAR PURPOSE.  See the
 *     GNU General Public License for more details.
 *
 * Or, alternatively,
 *
 *  b) Permission is hereby granted, free of charge, to any person
 *     obtaining a copy of this software and associated documentation
 *     files (the "Software"), to deal in the Software without
 *     restriction, including without limitation the rights to use,
 *     copy, modify, merge, publish, distribute, sublicense, and/or
 *     sell copies of the Software, and to permit persons to whom the
 *     Software is furnished to do so, subject to the following
 *     conditions:
 *
 *     The above copyright notice and this permission notice shall be
 *     included in all copies or substantial portions of the Software.
 *
 *     THE SOFTWARE IS PROVIDED "AS IS", WITHOUT WARRANTY OF ANY KIND,
 *     EXPRESS OR IMPLIED, INCLUDING BUT NOT LIMITED TO THE WARRANTIES
 *     OF MERCHANTABILITY, FITNESS FOR A PARTICULAR PURPOSE AND
 *     NONINFRINGEMENT. IN NO EVENT SHALL THE AUTHORS OR COPYRIGHT
 *     HOLDERS BE LIABLE FOR ANY CLAIM, DAMAGES OR OTHER LIABILITY,
 *     WHETHER IN AN ACTION OF CONTRACT, TORT OR OTHERWISE, ARISING
 *     FROM, OUT OF OR IN CONNECTION WITH THE SOFTWARE OR THE USE OR
 *     OTHER DEALINGS IN THE SOFTWARE.
 */

&dsi {
	status = "okay";

	panel@0 {
		compatible = "corpro,gm8775c", "simple-panel-dsi";
		reset-gpios = <&gpio2 28 GPIO_ACTIVE_LOW>;
		enable-gpios = <&gpio3 29 GPIO_ACTIVE_HIGH>;
		reg = <0>;
		backlight = <&backlight>;
		dsi,flags = <(MIPI_DSI_MODE_VIDEO | MIPI_DSI_MODE_VIDEO_BURST |
			      MIPI_DSI_MODE_LPM | MIPI_DSI_MODE_EOT_PACKET)>;
		dsi,format = <MIPI_DSI_FMT_RGB888>;
		dsi,lanes = <4>;
        	rockchip,lane-rate = <396>;

		panel-init-sequence = [
			23 05 02  27 AA
			23 05 02  48 02
			23 05 02  B6 20
			23 05 02  01 00
			23 05 02  02 20
			23 05 02  03 35
			23 05 02  04 30
			23 05 02  05 20
			23 05 02  06 50
			23 05 02  07 00
			23 05 02  08 03
			23 05 02  09 06
			23 05 02  0A 0E
			23 05 02  0B 82
			23 05 02  0C 21
			23 05 02  0D 01
			23 05 02  0E 80
			23 05 02  0F 20
			23 05 02  10 20
			23 05 02  11 03
			23 05 02  12 1B
			23 05 02  13 03
			23 05 02  14 01
			23 05 02  15 23
			23 05 02  16 40
			23 05 02  17 1F
			23 05 02  18 01
			23 05 02  19 23
			23 05 02  1A 40
			23 05 02  1B 1F
			23 05 02  1E 46
			23 05 02  51 30
			23 05 02  1F 10
			23 05 02  2A 01
		];

		display-timings {
			native-mode = <&gm8775c_timing>;

			gm8775c_timing: timing0 {
				clock-frequency = <69000000>;
				hactive = <1280>;
				vactive = <800>;
				hback-porch = <140>;
				hfront-porch = <18>;
				vback-porch = <8>;
				vfront-porch = <6>;
				hsync-len = <10>;
				vsync-len = <2>;
				hsync-active = <0>;
				vsync-active = <0>;
				de-active = <0>;
                		pixelclk-active = <0>;
			};
		};
	};
};

